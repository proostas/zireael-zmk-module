## boards/arm/zireael/Kconfig
```kconfig
# Copyright (c) 2021 Rafael Yumagulov
# SPDX-License-Identifier: MIT

config BOARD_ENABLE_DCDC
	bool "Enable DCDC mode"
	select SOC_DCDC_NRF52X
	default y
	depends on (BOARD_ZIREAEL_LEFT || BOARD_ZIREAEL_RIGHT)
```

## boards/arm/zireael/Kconfig.board
```kconfig
# Dao board configuration

# Copyright (c) 2021 Rafael Yumagulov
# SPDX-License-Identifier: MIT

config BOARD_ZIREAEL_LEFT
	bool "zireael_left"
	depends on SOC_NRF52840_QIAA

config BOARD_ZIREAEL_RIGHT
	bool "zireael_right"
	depends on SOC_NRF52840_QIAA
```

## boards/arm/zireael/Kconfig.defconfig
```kconfig
# Copyright (c) 2021 Rafael Yumagulov
# SPDX-License-Identifier: MIT

if BOARD_ZIREAEL_LEFT

	config ZMK_KEYBOARD_NAME
	default "Zireael"

    config ZMK_SPLIT_BLE_ROLE_CENTRAL
	default y

endif # BOARD_ZIREAEL_LEFT

if BOARD_ZIREAEL_LEFT || BOARD_ZIREAEL_RIGHT

config BOARD
	default "zireael"

config ZMK_SPLIT
	default y

config BT_CTLR

	default BT

config ZMK_BATTERY_VOLTAGE_DIVIDER
	default y

if USB

config USB_NRFX
	default y

config USB_DEVICE_STACK
	default y

endif # USB

endif # BOARD_ZIREAEL_LEFT || BOARD_ZIREAEL_RIGHT
```
